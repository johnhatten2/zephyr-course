## twister-out/native_sim_native/host/homework.unit.temp_alarm.ordered/Kconfig/arch/Kconfig
```kconfig
# Load Zephyr Arch Kconfig descriptions.
osource "/home/jonathan/Documents/work/training/iomico-zephyr-intermediate/deps/zephyr/arch/rx/Kconfig"
osource "/home/jonathan/Documents/work/training/iomico-zephyr-intermediate/deps/zephyr/arch/x86/Kconfig"
osource "/home/jonathan/Documents/work/training/iomico-zephyr-intermediate/deps/zephyr/arch/xtensa/Kconfig"
osource "/home/jonathan/Documents/work/training/iomico-zephyr-intermediate/deps/zephyr/arch/sparc/Kconfig"
osource "/home/jonathan/Documents/work/training/iomico-zephyr-intermediate/deps/zephyr/arch/riscv/Kconfig"
osource "/home/jonathan/Documents/work/training/iomico-zephyr-intermediate/deps/zephyr/arch/posix/Kconfig"
osource "/home/jonathan/Documents/work/training/iomico-zephyr-intermediate/deps/zephyr/arch/mips/Kconfig"
osource "/home/jonathan/Documents/work/training/iomico-zephyr-intermediate/deps/zephyr/arch/arm64/Kconfig"
osource "/home/jonathan/Documents/work/training/iomico-zephyr-intermediate/deps/zephyr/arch/arm/Kconfig"
osource "/home/jonathan/Documents/work/training/iomico-zephyr-intermediate/deps/zephyr/arch/arc/Kconfig"
```

## twister-out/native_sim_native/host/homework.unit.temp_alarm.ordered/Kconfig/boards/Kconfig.sysbuild
```kconfig
# Load Sysbuild board Kconfig descriptions.
osource "/home/jonathan/Documents/work/training/iomico-zephyr-intermediate/deps/zephyr/boards/native/native_sim/Kconfig.sysbuild"
```

## twister-out/native_sim_native/host/homework.unit.temp_alarm.ordered/Kconfig/soc/Kconfig
```kconfig
# Load Zephyr SoC Kconfig descriptions.
osource "/home/jonathan/Documents/work/training/iomico-zephyr-intermediate/deps/zephyr/soc/xlnx/zynqmp/Kconfig"
osource "/home/jonathan/Documents/work/training/iomico-zephyr-intermediate/deps/zephyr/soc/xlnx/zynq7000/Kconfig"
osource "/home/jonathan/Documents/work/training/iomico-zephyr-intermediate/deps/zephyr/soc/xlnx/versalnet/Kconfig"
osource "/home/jonathan/Documents/work/training/iomico-zephyr-intermediate/deps/zephyr/soc/xlnx/versal2/Kconfig"
osource "/home/jonathan/Documents/work/training/iomico-zephyr-intermediate/deps/zephyr/soc/xen/Kconfig"
osource "/home/jonathan/Documents/work/training/iomico-zephyr-intermediate/deps/zephyr/soc/wch/ch32v/Kconfig"
osource "/home/jonathan/Documents/work/training/iomico-zephyr-intermediate/deps/zephyr/soc/ti/simplelink/Kconfig"
osource "/home/jonathan/Documents/work/training/iomico-zephyr-intermediate/deps/zephyr/soc/ti/mspm0/Kconfig"
osource "/home/jonathan/Documents/work/training/iomico-zephyr-intermediate/deps/zephyr/soc/ti/lm3s6965/Kconfig"
osource "/home/jonathan/Documents/work/training/iomico-zephyr-intermediate/deps/zephyr/soc/ti/k3/Kconfig"
osource "/home/jonathan/Documents/work/training/iomico-zephyr-intermediate/deps/zephyr/soc/telink/tlsr/Kconfig"
osource "/home/jonathan/Documents/work/training/iomico-zephyr-intermediate/deps/zephyr/soc/starfive/jh71xx/Kconfig"
osource "/home/jonathan/Documents/work/training/iomico-zephyr-intermediate/deps/zephyr/soc/st/stm32/Kconfig"
osource "/home/jonathan/Documents/work/training/iomico-zephyr-intermediate/deps/zephyr/soc/snps/qemu_arc/Kconfig"
osource "/home/jonathan/Documents/work/training/iomico-zephyr-intermediate/deps/zephyr/soc/snps/nsim/arc_v/Kconfig"
osource "/home/jonathan/Documents/work/training/iomico-zephyr-intermediate/deps/zephyr/soc/snps/nsim/arc_classic/Kconfig"
osource "/home/jonathan/Documents/work/training/iomico-zephyr-intermediate/deps/zephyr/soc/snps/hsdk4xd/Kconfig"
osource "/home/jonathan/Documents/work/training/iomico-zephyr-intermediate/deps/zephyr/soc/snps/hsdk/Kconfig"
osource "/home/jonathan/Documents/work/training/iomico-zephyr-intermediate/deps/zephyr/soc/snps/emsk/Kconfig"
osource "/home/jonathan/Documents/work/training/iomico-zephyr-intermediate/deps/zephyr/soc/snps/emsdp/Kconfig"
osource "/home/jonathan/Documents/work/training/iomico-zephyr-intermediate/deps/zephyr/soc/snps/arc_iot/Kconfig"
osource "/home/jonathan/Documents/work/training/iomico-zephyr-intermediate/deps/zephyr/soc/silabs/Kconfig"
osource "/home/jonathan/Documents/work/training/iomico-zephyr-intermediate/deps/zephyr/soc/sifive/sifive_freedom/Kconfig"
osource "/home/jonathan/Documents/work/training/iomico-zephyr-intermediate/deps/zephyr/soc/sensry/Kconfig"
osource "/home/jonathan/Documents/work/training/iomico-zephyr-intermediate/deps/zephyr/soc/rockchip/Kconfig"
osource "/home/jonathan/Documents/work/training/iomico-zephyr-intermediate/deps/zephyr/soc/renode/riscv_virtual/Kconfig"
osource "/home/jonathan/Documents/work/training/iomico-zephyr-intermediate/deps/zephyr/soc/renode/cortex_r8_virtual/Kconfig"
osource "/home/jonathan/Documents/work/training/iomico-zephyr-intermediate/deps/zephyr/soc/renesas/smartbond/Kconfig"
osource "/home/jonathan/Documents/work/training/iomico-zephyr-intermediate/deps/zephyr/soc/renesas/rz/Kconfig"
osource "/home/jonathan/Documents/work/training/iomico-zephyr-intermediate/deps/zephyr/soc/renesas/rx/Kconfig"
osource "/home/jonathan/Documents/work/training/iomico-zephyr-intermediate/deps/zephyr/soc/renesas/rcar/Kconfig"
osource "/home/jonathan/Documents/work/training/iomico-zephyr-intermediate/deps/zephyr/soc/renesas/ra/Kconfig"
osource "/home/jonathan/Documents/work/training/iomico-zephyr-intermediate/deps/zephyr/soc/realtek/ec/Kconfig"
osource "/home/jonathan/Documents/work/training/iomico-zephyr-intermediate/deps/zephyr/soc/raspberrypi/rpi_pico/Kconfig"
osource "/home/jonathan/Documents/work/training/iomico-zephyr-intermediate/deps/zephyr/soc/quicklogic/eos_s3/Kconfig"
osource "/home/jonathan/Documents/work/training/iomico-zephyr-intermediate/deps/zephyr/soc/qemu/virt_riscv/Kconfig"
osource "/home/jonathan/Documents/work/training/iomico-zephyr-intermediate/deps/zephyr/soc/qemu/malta/Kconfig"
osource "/home/jonathan/Documents/work/training/iomico-zephyr-intermediate/deps/zephyr/soc/openisa/rv32m1/Kconfig"
osource "/home/jonathan/Documents/work/training/iomico-zephyr-intermediate/deps/zephyr/soc/openhwgroup/cva6/Kconfig"
osource "/home/jonathan/Documents/work/training/iomico-zephyr-intermediate/deps/zephyr/soc/oct/osd32mp15x/Kconfig"
osource "/home/jonathan/Documents/work/training/iomico-zephyr-intermediate/deps/zephyr/soc/nxp/s32/Kconfig"
osource "/home/jonathan/Documents/work/training/iomico-zephyr-intermediate/deps/zephyr/soc/nxp/rw/Kconfig"
osource "/home/jonathan/Documents/work/training/iomico-zephyr-intermediate/deps/zephyr/soc/nxp/mcx/Kconfig"
osource "/home/jonathan/Documents/work/training/iomico-zephyr-intermediate/deps/zephyr/soc/nxp/lpc/Kconfig"
osource "/home/jonathan/Documents/work/training/iomico-zephyr-intermediate/deps/zephyr/soc/nxp/layerscape/Kconfig"
osource "/home/jonathan/Documents/work/training/iomico-zephyr-intermediate/deps/zephyr/soc/nxp/kinetis/Kconfig"
osource "/home/jonathan/Documents/work/training/iomico-zephyr-intermediate/deps/zephyr/soc/nxp/imxrt/Kconfig"
osource "/home/jonathan/Documents/work/training/iomico-zephyr-intermediate/deps/zephyr/soc/nxp/imx/Kconfig"
osource "/home/jonathan/Documents/work/training/iomico-zephyr-intermediate/deps/zephyr/soc/nuvoton/numicro/Kconfig"
osource "/home/jonathan/Documents/work/training/iomico-zephyr-intermediate/deps/zephyr/soc/nuvoton/numaker/Kconfig"
osource "/home/jonathan/Documents/work/training/iomico-zephyr-intermediate/deps/zephyr/soc/nuvoton/npcx/Kconfig"
osource "/home/jonathan/Documents/work/training/iomico-zephyr-intermediate/deps/zephyr/soc/nuvoton/npcm/Kconfig"
osource "/home/jonathan/Documents/work/training/iomico-zephyr-intermediate/deps/zephyr/soc/nordic/Kconfig"
osource "/home/jonathan/Documents/work/training/iomico-zephyr-intermediate/deps/zephyr/soc/neorv32/Kconfig"
osource "/home/jonathan/Documents/work/training/iomico-zephyr-intermediate/deps/zephyr/soc/native/inf_clock/Kconfig"
osource "/home/jonathan/Documents/work/training/iomico-zephyr-intermediate/deps/zephyr/soc/microchip/sam/Kconfig"
osource "/home/jonathan/Documents/work/training/iomico-zephyr-intermediate/deps/zephyr/soc/microchip/miv/Kconfig"
osource "/home/jonathan/Documents/work/training/iomico-zephyr-intermediate/deps/zephyr/soc/microchip/mec/Kconfig"
osource "/home/jonathan/Documents/work/training/iomico-zephyr-intermediate/deps/zephyr/soc/mediatek/mt8xxx/Kconfig"
osource "/home/jonathan/Documents/work/training/iomico-zephyr-intermediate/deps/zephyr/soc/lowrisc/opentitan/Kconfig"
osource "/home/jonathan/Documents/work/training/iomico-zephyr-intermediate/deps/zephyr/soc/litex/litex_vexriscv/Kconfig"
osource "/home/jonathan/Documents/work/training/iomico-zephyr-intermediate/deps/zephyr/soc/ite/ec/Kconfig"
osource "/home/jonathan/Documents/work/training/iomico-zephyr-intermediate/deps/zephyr/soc/intel/raptor_lake/Kconfig"
osource "/home/jonathan/Documents/work/training/iomico-zephyr-intermediate/deps/zephyr/soc/intel/lakemont/Kconfig"
osource "/home/jonathan/Documents/work/training/iomico-zephyr-intermediate/deps/zephyr/soc/intel/intel_socfpga_std/Kconfig"
osource "/home/jonathan/Documents/work/training/iomico-zephyr-intermediate/deps/zephyr/soc/intel/intel_socfpga/Kconfig"
osource "/home/jonathan/Documents/work/training/iomico-zephyr-intermediate/deps/zephyr/soc/intel/intel_niosv/Kconfig"
osource "/home/jonathan/Documents/work/training/iomico-zephyr-intermediate/deps/zephyr/soc/intel/intel_ish/Kconfig"
osource "/home/jonathan/Documents/work/training/iomico-zephyr-intermediate/deps/zephyr/soc/intel/intel_adsp/Kconfig"
osource "/home/jonathan/Documents/work/training/iomico-zephyr-intermediate/deps/zephyr/soc/intel/elkhart_lake/Kconfig"
osource "/home/jonathan/Documents/work/training/iomico-zephyr-intermediate/deps/zephyr/soc/intel/atom/Kconfig"
osource "/home/jonathan/Documents/work/training/iomico-zephyr-intermediate/deps/zephyr/soc/intel/apollo_lake/Kconfig"
osource "/home/jonathan/Documents/work/training/iomico-zephyr-intermediate/deps/zephyr/soc/intel/alder_lake/Kconfig"
osource "/home/jonathan/Documents/work/training/iomico-zephyr-intermediate/deps/zephyr/soc/infineon/cat3/Kconfig"
osource "/home/jonathan/Documents/work/training/iomico-zephyr-intermediate/deps/zephyr/soc/infineon/cat1c/Kconfig"
osource "/home/jonathan/Documents/work/training/iomico-zephyr-intermediate/deps/zephyr/soc/infineon/cat1b/Kconfig"
osource "/home/jonathan/Documents/work/training/iomico-zephyr-intermediate/deps/zephyr/soc/infineon/cat1a/Kconfig"
osource "/home/jonathan/Documents/work/training/iomico-zephyr-intermediate/deps/zephyr/soc/gd/gd32/Kconfig"
osource "/home/jonathan/Documents/work/training/iomico-zephyr-intermediate/deps/zephyr/soc/gaisler/leon3/Kconfig"
osource "/home/jonathan/Documents/work/training/iomico-zephyr-intermediate/deps/zephyr/soc/gaisler/gr716a/Kconfig"
osource "/home/jonathan/Documents/work/training/iomico-zephyr-intermediate/deps/zephyr/soc/espressif/Kconfig"
osource "/home/jonathan/Documents/work/training/iomico-zephyr-intermediate/deps/zephyr/soc/ene/kb1200/Kconfig"
osource "/home/jonathan/Documents/work/training/iomico-zephyr-intermediate/deps/zephyr/soc/ene/kb106x/Kconfig"
osource "/home/jonathan/Documents/work/training/iomico-zephyr-intermediate/deps/zephyr/soc/efinix/sapphire/Kconfig"
osource "/home/jonathan/Documents/work/training/iomico-zephyr-intermediate/deps/zephyr/soc/cdns/xtensa_sample_controller/Kconfig"
osource "/home/jonathan/Documents/work/training/iomico-zephyr-intermediate/deps/zephyr/soc/cdns/sample_controller32/Kconfig"
osource "/home/jonathan/Documents/work/training/iomico-zephyr-intermediate/deps/zephyr/soc/cdns/dc233c/Kconfig"
osource "/home/jonathan/Documents/work/training/iomico-zephyr-intermediate/deps/zephyr/soc/brcm/bcmvk/Kconfig"
osource "/home/jonathan/Documents/work/training/iomico-zephyr-intermediate/deps/zephyr/soc/brcm/bcm2712/Kconfig"
osource "/home/jonathan/Documents/work/training/iomico-zephyr-intermediate/deps/zephyr/soc/brcm/bcm2711/Kconfig"
osource "/home/jonathan/Documents/work/training/iomico-zephyr-intermediate/deps/zephyr/soc/bflb/Kconfig"
osource "/home/jonathan/Documents/work/training/iomico-zephyr-intermediate/deps/zephyr/soc/atmel/sam0/Kconfig"
osource "/home/jonathan/Documents/work/training/iomico-zephyr-intermediate/deps/zephyr/soc/atmel/sam/Kconfig"
osource "/home/jonathan/Documents/work/training/iomico-zephyr-intermediate/deps/zephyr/soc/aspeed/Kconfig"
osource "/home/jonathan/Documents/work/training/iomico-zephyr-intermediate/deps/zephyr/soc/arm/Kconfig"
osource "/home/jonathan/Documents/work/training/iomico-zephyr-intermediate/deps/zephyr/soc/arm/beetle/Kconfig"
osource "/home/jonathan/Documents/work/training/iomico-zephyr-intermediate/deps/zephyr/soc/antmicro/myra/Kconfig"
osource "/home/jonathan/Documents/work/training/iomico-zephyr-intermediate/deps/zephyr/soc/andestech/Kconfig"
osource "/home/jonathan/Documents/work/training/iomico-zephyr-intermediate/deps/zephyr/soc/amd/acp_6_0/Kconfig"
osource "/home/jonathan/Documents/work/training/iomico-zephyr-intermediate/deps/zephyr/soc/ambiq/Kconfig"
osource "/home/jonathan/Documents/work/training/iomico-zephyr-intermediate/deps/zephyr/soc/aesc/Kconfig"
osource "/home/jonathan/Documents/work/training/iomico-zephyr-intermediate/deps/zephyr/soc/adi/max32/Kconfig"
```

## twister-out/native_sim_native/host/homework.unit.temp_alarm/Kconfig/Kconfig.modules
```kconfig
menu "cmsis_6 (/home/jonathan/Documents/work/training/iomico-zephyr-intermediate/deps/modules/hal/cmsis_6)"
osource "$(ZEPHYR_CMSIS_6_KCONFIG)"
config ZEPHYR_CMSIS_6_MODULE
	bool
	default y
endmenu
menu "hal_nordic (/home/jonathan/Documents/work/training/iomico-zephyr-intermediate/deps/modules/hal/nordic)"
osource "$(ZEPHYR_HAL_NORDIC_KCONFIG)"
config ZEPHYR_HAL_NORDIC_MODULE
	bool
	default y

config ZEPHYR_HAL_NORDIC_MODULE_BLOBS
	bool
endmenu
menu "hal_nxp (/home/jonathan/Documents/work/training/iomico-zephyr-intermediate/deps/modules/hal/nxp)"
osource "$(ZEPHYR_HAL_NXP_KCONFIG)"
config ZEPHYR_HAL_NXP_MODULE
	bool
	default y

config ZEPHYR_HAL_NXP_MODULE_BLOBS
	bool
endmenu
config ZEPHYR_HAL_STM32_MODULE
	bool
	default y

config ZEPHYR_HAL_STM32_MODULE_BLOBS
	bool
```

## twister-out/native_sim_native/host/homework.unit.temp_alarm/Kconfig/boards/Kconfig
```kconfig
# Load Zephyr board Kconfig descriptions.
osource "/home/jonathan/Documents/work/training/iomico-zephyr-intermediate/deps/zephyr/boards/native/native_sim/Kconfig"
```

## twister-out/native_sim_native/host/homework.unit.temp_alarm/Kconfig/boards/Kconfig.native_sim
```kconfig
# Load board Kconfig descriptions.
osource "/home/jonathan/Documents/work/training/iomico-zephyr-intermediate/deps/zephyr/boards/native/native_sim/Kconfig.native_sim"
```
