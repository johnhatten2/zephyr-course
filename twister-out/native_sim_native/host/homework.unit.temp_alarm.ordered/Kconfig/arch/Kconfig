## twister-out/native_sim_native/host/homework.unit.temp_alarm/Kconfig/soc/Kconfig.sysbuild
```kconfig
# Load Sysbuild SoC Kconfig descriptions.
osource "/home/jonathan/Documents/work/training/iomico-zephyr-intermediate/deps/zephyr/soc/xlnx/zynqmp/Kconfig.sysbuild"
osource "/home/jonathan/Documents/work/training/iomico-zephyr-intermediate/deps/zephyr/soc/xlnx/zynq7000/Kconfig.sysbuild"
osource "/home/jonathan/Documents/work/training/iomico-zephyr-intermediate/deps/zephyr/soc/xlnx/versalnet/Kconfig.sysbuild"
osource "/home/jonathan/Documents/work/training/iomico-zephyr-intermediate/deps/zephyr/soc/xlnx/versal2/Kconfig.sysbuild"
osource "/home/jonathan/Documents/work/training/iomico-zephyr-intermediate/deps/zephyr/soc/xen/Kconfig.sysbuild"
osource "/home/jonathan/Documents/work/training/iomico-zephyr-intermediate/deps/zephyr/soc/wch/ch32v/Kconfig.sysbuild"
osource "/home/jonathan/Documents/work/training/iomico-zephyr-intermediate/deps/zephyr/soc/ti/simplelink/Kconfig.sysbuild"
osource "/home/jonathan/Documents/work/training/iomico-zephyr-intermediate/deps/zephyr/soc/ti/mspm0/Kconfig.sysbuild"
osource "/home/jonathan/Documents/work/training/iomico-zephyr-intermediate/deps/zephyr/soc/ti/lm3s6965/Kconfig.sysbuild"
osource "/home/jonathan/Documents/work/training/iomico-zephyr-intermediate/deps/zephyr/soc/ti/k3/Kconfig.sysbuild"
osource "/home/jonathan/Documents/work/training/iomico-zephyr-intermediate/deps/zephyr/soc/telink/tlsr/Kconfig.sysbuild"
osource "/home/jonathan/Documents/work/training/iomico-zephyr-intermediate/deps/zephyr/soc/starfive/jh71xx/Kconfig.sysbuild"
osource "/home/jonathan/Documents/work/training/iomico-zephyr-intermediate/deps/zephyr/soc/st/stm32/Kconfig.sysbuild"
osource "/home/jonathan/Documents/work/training/iomico-zephyr-intermediate/deps/zephyr/soc/snps/qemu_arc/Kconfig.sysbuild"
osource "/home/jonathan/Documents/work/training/iomico-zephyr-intermediate/deps/zephyr/soc/snps/nsim/arc_v/Kconfig.sysbuild"
osource "/home/jonathan/Documents/work/training/iomico-zephyr-intermediate/deps/zephyr/soc/snps/nsim/arc_classic/Kconfig.sysbuild"
osource "/home/jonathan/Documents/work/training/iomico-zephyr-intermediate/deps/zephyr/soc/snps/hsdk4xd/Kconfig.sysbuild"
osource "/home/jonathan/Documents/work/training/iomico-zephyr-intermediate/deps/zephyr/soc/snps/hsdk/Kconfig.sysbuild"
osource "/home/jonathan/Documents/work/training/iomico-zephyr-intermediate/deps/zephyr/soc/snps/emsk/Kconfig.sysbuild"
osource "/home/jonathan/Documents/work/training/iomico-zephyr-intermediate/deps/zephyr/soc/snps/emsdp/Kconfig.sysbuild"
osource "/home/jonathan/Documents/work/training/iomico-zephyr-intermediate/deps/zephyr/soc/snps/arc_iot/Kconfig.sysbuild"
osource "/home/jonathan/Documents/work/training/iomico-zephyr-intermediate/deps/zephyr/soc/silabs/Kconfig.sysbuild"
osource "/home/jonathan/Documents/work/training/iomico-zephyr-intermediate/deps/zephyr/soc/sifive/sifive_freedom/Kconfig.sysbuild"
osource "/home/jonathan/Documents/work/training/iomico-zephyr-intermediate/deps/zephyr/soc/sensry/Kconfig.sysbuild"
osource "/home/jonathan/Documents/work/training/iomico-zephyr-intermediate/deps/zephyr/soc/rockchip/Kconfig.sysbuild"
osource "/home/jonathan/Documents/work/training/iomico-zephyr-intermediate/deps/zephyr/soc/renode/riscv_virtual/Kconfig.sysbuild"
osource "/home/jonathan/Documents/work/training/iomico-zephyr-intermediate/deps/zephyr/soc/renode/cortex_r8_virtual/Kconfig.sysbuild"
osource "/home/jonathan/Documents/work/training/iomico-zephyr-intermediate/deps/zephyr/soc/renesas/smartbond/Kconfig.sysbuild"
osource "/home/jonathan/Documents/work/training/iomico-zephyr-intermediate/deps/zephyr/soc/renesas/rz/Kconfig.sysbuild"
osource "/home/jonathan/Documents/work/training/iomico-zephyr-intermediate/deps/zephyr/soc/renesas/rx/Kconfig.sysbuild"
osource "/home/jonathan/Documents/work/training/iomico-zephyr-intermediate/deps/zephyr/soc/renesas/rcar/Kconfig.sysbuild"
osource "/home/jonathan/Documents/work/training/iomico-zephyr-intermediate/deps/zephyr/soc/renesas/ra/Kconfig.sysbuild"
osource "/home/jonathan/Documents/work/training/iomico-zephyr-intermediate/deps/zephyr/soc/realtek/ec/Kconfig.sysbuild"
osource "/home/jonathan/Documents/work/training/iomico-zephyr-intermediate/deps/zephyr/soc/raspberrypi/rpi_pico/Kconfig.sysbuild"
osource "/home/jonathan/Documents/work/training/iomico-zephyr-intermediate/deps/zephyr/soc/quicklogic/eos_s3/Kconfig.sysbuild"
osource "/home/jonathan/Documents/work/training/iomico-zephyr-intermediate/deps/zephyr/soc/qemu/virt_riscv/Kconfig.sysbuild"
osource "/home/jonathan/Documents/work/training/iomico-zephyr-intermediate/deps/zephyr/soc/qemu/malta/Kconfig.sysbuild"
osource "/home/jonathan/Documents/work/training/iomico-zephyr-intermediate/deps/zephyr/soc/openisa/rv32m1/Kconfig.sysbuild"
osource "/home/jonathan/Documents/work/training/iomico-zephyr-intermediate/deps/zephyr/soc/openhwgroup/cva6/Kconfig.sysbuild"
osource "/home/jonathan/Documents/work/training/iomico-zephyr-intermediate/deps/zephyr/soc/oct/osd32mp15x/Kconfig.sysbuild"
osource "/home/jonathan/Documents/work/training/iomico-zephyr-intermediate/deps/zephyr/soc/nxp/s32/Kconfig.sysbuild"
osource "/home/jonathan/Documents/work/training/iomico-zephyr-intermediate/deps/zephyr/soc/nxp/rw/Kconfig.sysbuild"
osource "/home/jonathan/Documents/work/training/iomico-zephyr-intermediate/deps/zephyr/soc/nxp/mcx/Kconfig.sysbuild"
osource "/home/jonathan/Documents/work/training/iomico-zephyr-intermediate/deps/zephyr/soc/nxp/lpc/Kconfig.sysbuild"
osource "/home/jonathan/Documents/work/training/iomico-zephyr-intermediate/deps/zephyr/soc/nxp/layerscape/Kconfig.sysbuild"
osource "/home/jonathan/Documents/work/training/iomico-zephyr-intermediate/deps/zephyr/soc/nxp/kinetis/Kconfig.sysbuild"
osource "/home/jonathan/Documents/work/training/iomico-zephyr-intermediate/deps/zephyr/soc/nxp/imxrt/Kconfig.sysbuild"
osource "/home/jonathan/Documents/work/training/iomico-zephyr-intermediate/deps/zephyr/soc/nxp/imx/Kconfig.sysbuild"
osource "/home/jonathan/Documents/work/training/iomico-zephyr-intermediate/deps/zephyr/soc/nuvoton/numicro/Kconfig.sysbuild"
osource "/home/jonathan/Documents/work/training/iomico-zephyr-intermediate/deps/zephyr/soc/nuvoton/numaker/Kconfig.sysbuild"
osource "/home/jonathan/Documents/work/training/iomico-zephyr-intermediate/deps/zephyr/soc/nuvoton/npcx/Kconfig.sysbuild"
osource "/home/jonathan/Documents/work/training/iomico-zephyr-intermediate/deps/zephyr/soc/nuvoton/npcm/Kconfig.sysbuild"
osource "/home/jonathan/Documents/work/training/iomico-zephyr-intermediate/deps/zephyr/soc/nordic/Kconfig.sysbuild"
osource "/home/jonathan/Documents/work/training/iomico-zephyr-intermediate/deps/zephyr/soc/neorv32/Kconfig.sysbuild"
osource "/home/jonathan/Documents/work/training/iomico-zephyr-intermediate/deps/zephyr/soc/native/inf_clock/Kconfig.sysbuild"
osource "/home/jonathan/Documents/work/training/iomico-zephyr-intermediate/deps/zephyr/soc/microchip/sam/Kconfig.sysbuild"
osource "/home/jonathan/Documents/work/training/iomico-zephyr-intermediate/deps/zephyr/soc/microchip/miv/Kconfig.sysbuild"
osource "/home/jonathan/Documents/work/training/iomico-zephyr-intermediate/deps/zephyr/soc/microchip/mec/Kconfig.sysbuild"
osource "/home/jonathan/Documents/work/training/iomico-zephyr-intermediate/deps/zephyr/soc/mediatek/mt8xxx/Kconfig.sysbuild"
osource "/home/jonathan/Documents/work/training/iomico-zephyr-intermediate/deps/zephyr/soc/lowrisc/opentitan/Kconfig.sysbuild"
osource "/home/jonathan/Documents/work/training/iomico-zephyr-intermediate/deps/zephyr/soc/litex/litex_vexriscv/Kconfig.sysbuild"
osource "/home/jonathan/Documents/work/training/iomico-zephyr-intermediate/deps/zephyr/soc/ite/ec/Kconfig.sysbuild"
osource "/home/jonathan/Documents/work/training/iomico-zephyr-intermediate/deps/zephyr/soc/intel/raptor_lake/Kconfig.sysbuild"
osource "/home/jonathan/Documents/work/training/iomico-zephyr-intermediate/deps/zephyr/soc/intel/lakemont/Kconfig.sysbuild"
osource "/home/jonathan/Documents/work/training/iomico-zephyr-intermediate/deps/zephyr/soc/intel/intel_socfpga_std/Kconfig.sysbuild"
osource "/home/jonathan/Documents/work/training/iomico-zephyr-intermediate/deps/zephyr/soc/intel/intel_socfpga/Kconfig.sysbuild"
osource "/home/jonathan/Documents/work/training/iomico-zephyr-intermediate/deps/zephyr/soc/intel/intel_niosv/Kconfig.sysbuild"
osource "/home/jonathan/Documents/work/training/iomico-zephyr-intermediate/deps/zephyr/soc/intel/intel_ish/Kconfig.sysbuild"
osource "/home/jonathan/Documents/work/training/iomico-zephyr-intermediate/deps/zephyr/soc/intel/intel_adsp/Kconfig.sysbuild"
osource "/home/jonathan/Documents/work/training/iomico-zephyr-intermediate/deps/zephyr/soc/intel/elkhart_lake/Kconfig.sysbuild"
osource "/home/jonathan/Documents/work/training/iomico-zephyr-intermediate/deps/zephyr/soc/intel/atom/Kconfig.sysbuild"
osource "/home/jonathan/Documents/work/training/iomico-zephyr-intermediate/deps/zephyr/soc/intel/apollo_lake/Kconfig.sysbuild"
osource "/home/jonathan/Documents/work/training/iomico-zephyr-intermediate/deps/zephyr/soc/intel/alder_lake/Kconfig.sysbuild"
osource "/home/jonathan/Documents/work/training/iomico-zephyr-intermediate/deps/zephyr/soc/infineon/cat3/Kconfig.sysbuild"
osource "/home/jonathan/Documents/work/training/iomico-zephyr-intermediate/deps/zephyr/soc/infineon/cat1c/Kconfig.sysbuild"
osource "/home/jonathan/Documents/work/training/iomico-zephyr-intermediate/deps/zephyr/soc/infineon/cat1b/Kconfig.sysbuild"
osource "/home/jonathan/Documents/work/training/iomico-zephyr-intermediate/deps/zephyr/soc/infineon/cat1a/Kconfig.sysbuild"
osource "/home/jonathan/Documents/work/training/iomico-zephyr-intermediate/deps/zephyr/soc/gd/gd32/Kconfig.sysbuild"
osource "/home/jonathan/Documents/work/training/iomico-zephyr-intermediate/deps/zephyr/soc/gaisler/leon3/Kconfig.sysbuild"
osource "/home/jonathan/Documents/work/training/iomico-zephyr-intermediate/deps/zephyr/soc/gaisler/gr716a/Kconfig.sysbuild"
osource "/home/jonathan/Documents/work/training/iomico-zephyr-intermediate/deps/zephyr/soc/espressif/Kconfig.sysbuild"
osource "/home/jonathan/Documents/work/training/iomico-zephyr-intermediate/deps/zephyr/soc/ene/kb1200/Kconfig.sysbuild"
osource "/home/jonathan/Documents/work/training/iomico-zephyr-intermediate/deps/zephyr/soc/ene/kb106x/Kconfig.sysbuild"
osource "/home/jonathan/Documents/work/training/iomico-zephyr-intermediate/deps/zephyr/soc/efinix/sapphire/Kconfig.sysbuild"
osource "/home/jonathan/Documents/work/training/iomico-zephyr-intermediate/deps/zephyr/soc/cdns/xtensa_sample_controller/Kconfig.sysbuild"
osource "/home/jonathan/Documents/work/training/iomico-zephyr-intermediate/deps/zephyr/soc/cdns/sample_controller32/Kconfig.sysbuild"
osource "/home/jonathan/Documents/work/training/iomico-zephyr-intermediate/deps/zephyr/soc/cdns/dc233c/Kconfig.sysbuild"
osource "/home/jonathan/Documents/work/training/iomico-zephyr-intermediate/deps/zephyr/soc/brcm/bcmvk/Kconfig.sysbuild"
osource "/home/jonathan/Documents/work/training/iomico-zephyr-intermediate/deps/zephyr/soc/brcm/bcm2712/Kconfig.sysbuild"
osource "/home/jonathan/Documents/work/training/iomico-zephyr-intermediate/deps/zephyr/soc/brcm/bcm2711/Kconfig.sysbuild"
osource "/home/jonathan/Documents/work/training/iomico-zephyr-intermediate/deps/zephyr/soc/bflb/Kconfig.sysbuild"
osource "/home/jonathan/Documents/work/training/iomico-zephyr-intermediate/deps/zephyr/soc/atmel/sam0/Kconfig.sysbuild"
osource "/home/jonathan/Documents/work/training/iomico-zephyr-intermediate/deps/zephyr/soc/atmel/sam/Kconfig.sysbuild"
osource "/home/jonathan/Documents/work/training/iomico-zephyr-intermediate/deps/zephyr/soc/aspeed/Kconfig.sysbuild"
osource "/home/jonathan/Documents/work/training/iomico-zephyr-intermediate/deps/zephyr/soc/arm/Kconfig.sysbuild"
osource "/home/jonathan/Documents/work/training/iomico-zephyr-intermediate/deps/zephyr/soc/arm/beetle/Kconfig.sysbuild"
osource "/home/jonathan/Documents/work/training/iomico-zephyr-intermediate/deps/zephyr/soc/antmicro/myra/Kconfig.sysbuild"
osource "/home/jonathan/Documents/work/training/iomico-zephyr-intermediate/deps/zephyr/soc/andestech/Kconfig.sysbuild"
osource "/home/jonathan/Documents/work/training/iomico-zephyr-intermediate/deps/zephyr/soc/amd/acp_6_0/Kconfig.sysbuild"
osource "/home/jonathan/Documents/work/training/iomico-zephyr-intermediate/deps/zephyr/soc/ambiq/Kconfig.sysbuild"
osource "/home/jonathan/Documents/work/training/iomico-zephyr-intermediate/deps/zephyr/soc/aesc/Kconfig.sysbuild"
osource "/home/jonathan/Documents/work/training/iomico-zephyr-intermediate/deps/zephyr/soc/adi/max32/Kconfig.sysbuild"
```
